## configs/mt7688-devboard_defconfig
```kconfig
BR2_mipsel=y
BR2_mips_32r2=y
BR2_KERNEL_HEADERS_5_4=y
BR2_BINUTILS_VERSION_2_32_X=y
BR2_GCC_VERSION_8_X=y
BR2_ROOTFS_POST_IMAGE_SCRIPT="support/scripts/genimage.sh"
BR2_ROOTFS_POST_SCRIPT_ARGS="-c $(BR2_EXTERNAL_MT76X8_PATH)/board/mt7688-devboard/genimage.cfg"
BR2_LINUX_KERNEL=y
BR2_LINUX_KERNEL_CUSTOM_VERSION=y
BR2_LINUX_KERNEL_CUSTOM_VERSION_VALUE="5.4.99"
BR2_LINUX_KERNEL_USE_CUSTOM_CONFIG=y
BR2_LINUX_KERNEL_CUSTOM_CONFIG_FILE="$(BR2_EXTERNAL_MT76X8_PATH)/board/mt7688-devboard/kernel.defconfig"
BR2_LINUX_KERNEL_DTS_SUPPORT=y
BR2_LINUX_KERNEL_INTREE_DTS_NAME="ralink/mt7688-devboard.kernel"
BR2_PACKAGE_UBOOT_TOOLS=y
# BR2_PACKAGE_UBOOT_TOOLS_FWPRINTENV is not set
BR2_PACKAGE_SWUPDATE=y
# BR2_PACKAGE_SWUPDATE_INSTALL_WEBSITE is not set
BR2_TARGET_ROOTFS_CPIO=y
BR2_TARGET_ROOTFS_CPIO_GZIP=y
BR2_TARGET_ROOTFS_CPIO_UIMAGE=y
BR2_TARGET_ROOTFS_SQUASHFS=y
# BR2_TARGET_ROOTFS_TAR is not set
BR2_TARGET_UBOOT=y
BR2_TARGET_UBOOT_BUILD_SYSTEM_KCONFIG=y
BR2_TARGET_UBOOT_CUSTOM_VERSION=y
BR2_TARGET_UBOOT_CUSTOM_VERSION_VALUE="2021.01"
BR2_TARGET_UBOOT_PATCH="$(BR2_EXTERNAL_MT76X8_PATH)/patches/uboot/2021.01/0001-build-mt7688-devboard-dtb.patch"
BR2_TARGET_UBOOT_USE_CUSTOM_CONFIG=y
BR2_TARGET_UBOOT_CUSTOM_CONFIG_FILE="$(BR2_EXTERNAL_MT76X8_PATH)/board/mt7688-devboard/u-boot.defconfig"
BR2_TARGET_UBOOT_NEEDS_DTC=y
# BR2_TARGET_UBOOT_FORMAT_BIN is not set
BR2_TARGET_UBOOT_FORMAT_CUSTOM=y
BR2_TARGET_UBOOT_FORMAT_CUSTOM_NAME="u-boot-with-spl.bin"
BR2_TARGET_UBOOT_CUSTOM_DTS_PATH="$(BR2_EXTERNAL_MT76X8_PATH)/board/mt7688-devboard/mt7688-devboard.u-boot.dts"
BR2_PACKAGE_HOST_UBOOT_TOOLS_ENVIMAGE=y
BR2_PACKAGE_HOST_UBOOT_TOOLS_ENVIMAGE_SOURCE="$(BR2_EXTERNAL_MT76X8_PATH)/board/mt7688-devboard/u-boot.env"
BR2_PACKAGE_HOST_UBOOT_TOOLS_ENVIMAGE_SIZE="0x10000"
BR2_PACKAGE_HOST_UBOOT_TOOLS_ENVIMAGE_REDUNDANT=y
BR2_PACKAGE_HOST_QUILT=y
BR2_PACKAGE_HOST_GENIMAGE_14=y
BR2_PACKAGE_MT76X8=y
BR2_PACKAGE_QUECTEL_CM=y
```

## package/application/Config.in
```kconfig
config BR2_PACKAGE_APPLICATION
	bool "application"
	default y

	select BR2_PACKAGE_LIBUV
	select BR2_PACKAGE_LIBWEBSOCKETS
	select BR2_PACKAGE_LIBCONFIG
	select BR2_PACKAGE_FLASHROM_CUSTOM
	select BR2_PACKAGE_SER2NET
	select BR2_PACKAGE_LIBNL

	help
	  TODO
```

## package/jbol/Config.in
```kconfig
config BR2_PACKAGE_JBOL
	bool "jbol"

        select BR2_PACKAGE_JQ

        help
          TODO
```

## package/libwebsockets-custom/Config.in
```kconfig
config BR2_PACKAGE_LIBWEBSOCKETS_CUSTOM
	bool "libwebsockets-custom"
	depends on !BR2_STATIC_LIBS
	depends on !BR2_PACKAGE_LIBWEBSOCKETS
	select BR2_PACKAGE_ZLIB
	help
	  Libwebsockets is a lightweight pure C library built to use
	  minimal CPU and memory resources, and provide fast throughput
	  in both directions.

	  https://libwebsockets.org/

comment "libwebsockets needs a toolchain w/ dynamic library"
	depends on BR2_STATIC_LIBS

comment "disable libwesockets to enable custom version"
	depends on BR2_PACKAGE_LIBWEBSOCKETS
```

## package/linux-backports-custom/Config.in
```kconfig
config BR2_PACKAGE_LINUX_BACKPORTS_CUSTOM
	bool "linux-backports-custom"
	default y
	help
	  TODO
```

## package/mt76-mac80211/Config.in
```kconfig
config BR2_PACKAGE_MT76_MAC80211
	bool "mt76-mac80211"
	default y

	select BR2_PACKAGE_LINUX_BACKPORTS_CUSTOM
	select BR2_PACKAGE_WIRELESS_REGDB

	help
	  TODO
```

## package/quilt/Config.in.host
```kconfig
config BR2_PACKAGE_HOST_QUILT
	bool "host-quilt"
	default y

	help
	  Quilt allows you to easily manage large numbers of patches
	  by keeping track of the changes each patch makes.
	  Patches can be applied, un-applied, refreshed, and more.

	  https://savannah.nongnu.org/projects/quilt
```

## package/swconfig/Config.in
```kconfig
config BR2_PACKAGE_SWCONFIG
	bool "swconfig"
	default y

	select BR2_PACKAGE_LIBNL

	help
	  The program swconfig allows you to configure configurable
	  Ethernet network switches.

	  https://oldwiki.archive.openwrt.org/doc/techref/swconfig
```
